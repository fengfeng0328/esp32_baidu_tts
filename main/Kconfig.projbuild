## main/Kconfig.projbuild
```kconfig
menu "A2DP Example Configuration"

choice A2DP_SINK_OUTPUT
    prompt "A2DP Sink Output"
    default A2DP_SINK_OUTPUT_EXTERNAL_I2S
    help
        Select to use Internal DAC or external I2S driver

config A2DP_SINK_OUTPUT_INTERNAL_DAC
    bool "Internal DAC"
    help
        Select this to use Internal DAC sink output

config A2DP_SINK_OUTPUT_EXTERNAL_I2S
    bool "External I2S Codec"
    help
        Select this to use External I2S sink output
        
config A2DP_SINK_OUTPUT_EXTERNAL_I2S_AC101
    bool "External I2S Codec_ac101"
    help
        Select this to use External I2S sink output by AC101

endchoice

config I2S_LRCK_PIN
    int "I2S LRCK (WS) GPIO"
    default 22
    depends on A2DP_SINK_OUTPUT_EXTERNAL_I2S
    help
        GPIO number to use for I2S LRCK(WS) Driver.

config I2S_BCK_PIN
    int "I2S BCK GPIO"
    default 26
    depends on A2DP_SINK_OUTPUT_EXTERNAL_I2S
    help
        GPIO number to use for I2S BCK Driver.

config I2S_DATA_PIN
    int "I2S DATA GPIO"
    default 25
    depends on A2DP_SINK_OUTPUT_EXTERNAL_I2S
    help
        GPIO number to use for I2S Data Driver.

config AC101_I2S_LRCK_PIN
    int "I2S LRCK (WS) GPIO"
    default 27
    depends on A2DP_SINK_OUTPUT_EXTERNAL_I2S_AC101
    help
        GPIO number to use for I2S LRCK(WS) Driver.

config AC101_I2S_BCK_PIN
    int "I2S BCK GPIO"
    default 26
    depends on A2DP_SINK_OUTPUT_EXTERNAL_I2S_AC101
    help
        GPIO number to use for I2S BCK Driver.

config AC101_I2S_DATA_PIN
    int "I2S DATA GPIO"
    default 25
    depends on A2DP_SINK_OUTPUT_EXTERNAL_I2S_AC101
    help
        GPIO number to use for I2S Data Driver.
        
 config AC101_I2S_MCLK_PIN
    int "I2S MCLK (CLK) GPIO"
    default 0
    depends on A2DP_SINK_OUTPUT_EXTERNAL_I2S_AC101
    help
        GPIO number to use for I2S  MCLK(CLK) Driver.

endmenu

menu "WIFI Configuration"

choice ESP_WIFI_MODE
    prompt "AP or STA"
    default ESP_WIFI_IS_STATION
    help
        Whether the esp32 is softAP or station.

config ESP_WIFI_IS_SOFTAP
    bool "SoftAP"
config ESP_WIFI_IS_STATION
    bool "Station"
endchoice

config ESP_WIFI_MODE_AP
    bool
    default y if ESP_WIFI_IS_SOFTAP
    default n if ESP_WIFI_IS_STATION

config ESP_WIFI_SSID
    string "WiFi SSID"
    default "myssid"
    help
	SSID (network name) for the example to connect to.

config ESP_WIFI_PASSWORD
    string "WiFi Password"
    default "mypassword"
    help
	WiFi password (WPA or WPA2) for the example to use.
		
config MAX_STA_CONN
    int "Max STA conn"
    default 4
    help
	Max number of the STA connects to AP.
endmenu
```
